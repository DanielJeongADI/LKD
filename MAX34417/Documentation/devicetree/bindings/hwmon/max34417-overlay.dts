/dts-v1/;
/plugin/;


/ {
	compatible = "brcm,bcm2711", "brcm,bcm2708", "brcm,bcm2835", "brcm,bcm2837";

	fragment@0 {
		target = <&i2c_gpio>;
		__dormant__ {
			#address-cells = <1>;
			#size-cells = <0>;
			status = "okay";

			max34417: max34417@10 {
				compatible = "maxim,max34417";
				reg = <0x10>;
				maxim,sense-resistor = <10>;
				status = "okay";
			};
		};
	};

	__overrides__ {
		max34417 = <0>,"+0";
		sense-resistor = <&max34417>, "maxim,sense-resistor:0";
	};
};
