## MAX77860/Documentation/devicetree/bindings/power/max77860-charger.txt
```
Device Tree bindings for max77860 Charger

Required Properties :
 - compatible : Should be "maxim,max77860-charger".

Optional Properties :
 - fast_charge_timer : fast charge timer (hr) 
 - fast_charge_current : fast charge current(mA)
 - charge_termination_voltage : CV voltage(mV)
 - topoff_timer : topoff timer (min)
 - topoff_current : topoff current (mA)
 - restart_threshold : restart threshold (mV)
 - input_current_limit : input current limit (mA)

Example:

		charger {
			compatible = "maxim,max77860-charger";
		};
```

## MAX77860/drivers/iio/adc/Kconfig
```kconfig
config MAX77860_ADC
	tristate "Maxim max77860 ADC driver"
	depends on MFD_MAX77860
	help
	  Say yes here to build support for Maxim max77860 ADC interface.

	  To compile this driver as a module, choose M here: the module will be
	  called max77860-adc.  
```

## MAX77860/drivers/mfd/Kconfig
```kconfig
config MFD_MAX77860
	tristate "Maxim Integrated MAX77860 PMIC Support"
	depends on I2C=y
	select MFD_CORE
	select REGMAP_I2C
	select REGMAP_IRQ
	help
	  Say yes here to add support for Maxim Integrated MAX77860. 
	  This is a 3A Switch Mode Charger with Integrated CC Detection.
	  This driver provides common support for accessing the device,
	  additional drivers must be enabled in order to use the functionality
	  of the device.
```

## MAX77860/drivers/power/supply/Kconfig
```kconfig
config CHARGER_MAX77860
	tristate "Maxim MAX77860 battery charger driver"
	depends on MFD_MAX77860
	help
	  Say Y to enable support for the Maxim MAX77860 battery charger.
```

## MAX77860/drivers/regulator/Kconfig
```kconfig
config REGULATOR_MAX77860
	tristate "Maxim 77860 Regulator"
	depends on MFD_MAX77860
	help
	  This driver controls a Maxim 77860 regulators via I2C bus.
	  The regulator includes one LDO named 'SAFEOUT' with programmable
	  voltages if 3.3V, 4.85V, 4.9V and 4.95V through I2C registers.
```

## MAX77932/Documentation/devicetree/bindings/regulator/max77932.txt
```
Maxim Integrated MAX77932 Dual Phase Switched Capacitor Converter

Required properties:
- compatible: "maxim,max77932"
- reg: I2C slave address

Optional properties:
  - maxim,ocp1-threshold_uA: initial OCP1 value between 4200000 and 9600000(uA)
    in 200000 step.
  - maxim,ocp2-threshold_mV: initial OCP2 value between 90 and 240(mV)
    in 10mV step.

Example:

	max77932: max77932@68 {
		compatible = "maxim,max77932";
		reg = <0x68>;

		maxim,ocp1-threshold_uA = <7400000>;
		maxim,ocp2-threshold_mV = <240>;
	};
```

## MAX77958/drivers/mfd/Kconfig
```kconfig
#
# Multifunction miscellaneous devices
#

config MFD_MAX77958
	bool "Maxim Integrated MAX77958 USBC/PD Support"
	depends on I2C=y
	help
	  Say yes here to add support for Maxim Integrated MAX77958. 
	  This is a complete solution for USB Type-C CC detection and
	  PD protocol implementation.
	  This driver provides common support for accessing the device,
	  additional drivers must be enabled in order to use the functionality
	  of the device.
```

## MAX77960/Documentation/devicetree/bindings/power/max77960.txt
```
Required properties :
 - compatible : "max77960"

Example:

&i2c_6 {                          
	status = "okay";              
	max77960: charger@69 {                 
		compatible = "max77960";  
		reg = <0x69>;
		max77960,irq-gpio = <&tlmm 92 0x00>;
	};
}; 
```

## MAX77960/drivers/power/Kconfig
```kconfig
config CHARGER_MAX77960
	bool "Maxim Integrated MAX77960 Charger Support"
	depends on I2C=y
	help
	  Say yes here to add support for Maxim Integrated MAX77960. 
  	  This is a high performance wide input 6A Buck-Boost charger.
  	  This driver provides common support for accessing the device,
  	  additional drivers must be enabled in order to use the functionality
 	  of the device.
```

## MAX77975/Documentation/devicetree/bindings/power/max77975.txt
```
Maxim MAX77975 and MAX77985 Charger Driver
~~~~~~~~~~~~~~~~~~~~~~~~~~~~~~~~~~~~~~~~~~~~~~~~~~~~~~~~~~~~

Required properties:
 - compatible      : should contain one of the following:
						"maxim,max77975"
						"maxim,max77985"
 - reg             : I2C bus address of the device (0x6B)

Optional properties: 
 - fast_charge_timer : fast charge timer (hr) 
 - fast_charge_current : fast charge current(mA)
 - charge_termination_voltage : CV voltage(mV)
 - topoff_timer : topoff timer (min)
 - topoff_current : topoff current (mA)
 - restart_threshold : restart threshold (mV)
 - input_current_limit : input current limit (mA)

Example:

    max77975: max77975@6B {
        compatible = "maxim,max77975";
        reg = <0x6B>;
        status = "ok";
        
        interrupt-parent = <&gpio>;
        interrupts = <16 0>;

        fast_charge_timer = <0>; /* disable */
        fast_charge_current = <1500>; /* mA */
        charge_termination_voltage = <4350>; /* mV */
        topoff_timer = <30>; /* min */
        topoff_current = <150>; /* mA */
        restart_threshold = <150>; /* mV */
        input_current_limit = <500>; /* mA */
    };
```

## MAX77975/drivers/power/supply/Kconfig
```kconfig
config CHARGER_MAX77975
	bool "Maxim Integrated MAX77975 Charger driver"
	depends on I2C=y
	help
	  Say Y to enable support for the Maxim MAX77975 charger.
```

## drivers/misc/max77696/Kconfig
```kconfig
config MAX77696_CLK
	bool "MAX77696 crystal-based oscillator support"
	depends on MFD_MAX77696
	help
	  If you say yes here you get support for MAX77696 32KHz oscillator and
	  buffered outputs.

config MAX77696_UIC
	bool "MAX77696 UIC support"
	depends on MFD_MAX77696
	help
	  If you say yes here you get support for MAX77696 USB Interface Circuit.
```
