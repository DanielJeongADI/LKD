## MAX1720x_MAX1730x/Documentation/devicetree/bindings/power/maxim,max17201.txt
```
Maxim Max17201/Max17205 Stand-Alone ModelGauge m5 Fuel Gauge
~~~~~~~~~~~~~~~~~~~~~~~~~~~~~~~~~~~~~~~~~~~~~~~~~~~~~~~~~~~~

Required properties:
 - compatible      : should contain one of the following:
						"maxim,max17201"
						"maxim,max17205"
						"maxim,max17301"
						"maxim,max17302"
						"maxim,max17303"
 - reg             : I2C bus address of the device (0x36)

Optional properties:
 - maxim,rsense    : Rsense register value in miliOhm
 - maxim,talrt-min : Lower temperature limit(in DegreeC) that generates ALRT1 pin interrupt
 - maxim,talrt-max : Upper temperature limit(in DegreeC) that generates ALRT1 pin interrupt
 - maxim,valrt-min : Lower voltage limit(in mV) that generates ALRT1 pin interrupt
 - maxim,valrt-max : Upper voltage limit(in mV) that generates ALRT1 pin interrupt
 - maxim,salrt-min : Lower state of charge limit(in percent) that generates ALRT1 pin interrupt
 - maxim,salrt-max : Upper state of charge limit(in percent) that generates ALRT1 pin interrupt
 - maxim,ialrt-min : Lower current limit(in mA) that generates ALRT1 pin interrupt
 - maxim,ialrt-max : Upper current limit(in mA) that generates ALRT1 pin interrupt

Example:

	max17201@32 {
		compatible  = "maxim,max17201";
		reg         = <0x32>;
		rsense      = <10>;      /* miliOhm */
		talrt-min   = <0>;       /* DegreeC */
		talrt-max   = <50>;      /* DegreeC */
		valrt-min   = <3000>;    /* mV */
		valrt-max   = <4500>;    /* mV */
		salrt-min   = <1>;       /* Percent */
		salrt-max   = <99>;      /* Percent */
		ialrt-min   = <(-5000)>; /* mA */
		ialrt-max   = <5000>;    /* mA */
	};
```

## MAX1720x_MAX1730x/drivers/power/supply/Kconfig
```kconfig
config BATTERY_MAX1720x
	tristate "Maxim MAX1720x Fuel Gauge with Charger"
	depends on I2C
	help
	  Say Y to support for MAX172xx/MAX173xx Driver.
	  This driver controls Maxim MAX17201/MAX17205/MAX17301/2/3,
	  MAX17320 and MAX17330 standalone Model Gauge M5.
```

## MAX17332/Documentation/devicetree/bindings/mfd/max17332.txt
```
Maxim MAX17332 multi-functional device
MAX17332 is a Mulitifunction device with battery, charger.
* PMIC * Required properties:
 - compatible : Must be "maxim,max17332".
 - interrupt-parent : The parent interrupt controller.
 - interrupts : Interrupt number.
 - interrupt-controller : Mark the device node as an interrupt controller.
 - #interrupt-cells : Should be one. 
 	- The cell is the max17332 local IRQ number
 - rsense : Sense resistor selection.
 - max17332,pmic-init : Register values for initialization.
 - max17332,nvm-init : Register values for non-volatile memory initialization.
Nodes:
- battery

Example: max17332: max17332@36 {
				compatible = "maxim,max17332";;
				interrupt-parent = <&gpio>;
				interrupts = <16 0>;
				interrupt-cells = <1>;
				interrupt-controller;
				reg = <0x36>;
				status = "ok";
				rsense = <10>;		/* miliOhm */
				max17332,pmic-init = /bits/ 16 <0xAF 0xFF7C
												0x00 0xFFEE>;
				max17332,nvm-init = /bits/ 16 <0x9C 0x01E0
												0xA6 0x04B8
												0xB5 0x0000
												0xB9 0x2102
												0xC6 0x5005
												0xCB 0x3FFF
												0xCF 0x01F4
												0xD0 0x0008
												0xD1 0x5000
												0xD6 0x7A5F
												0xD7 0x3408
												0xD8 0x8BFF
												0xD9 0x2800
												0xDA 0xF3F4
												0xDB 0xFF00
												0xDC 0x1B3D
												0xDF 0x1065>;
				battery {
					compatible = "maxim,max17332-battery";
					status = "ok";
					/* Battery */
					talrt-min			= <0>;			/* DegreeC */
					talrt-max			= <50>;			/* DegreeC */
					valrt-min			= <3000>;		/* mV */
					valrt-max			= <4500>;		/* mV */
					salrt-min			= <1>;			/* Percent */
					salrt-max			= <99>;			/* Percent */
					ialrt-min			= <(-5000)>;	/* mA */
					ialrt-max			= <5000>;		/* mA */
				};
			};
```

## MAX17332/Documentation/devicetree/bindings/power/max17332-battery.txt
```
Device Tree bindings for max17332 Battery

Required Properties :
 - compatible : Should be "maxim,max17332-battery".

Optional Properties :
	talrt-min		/* DegreeC */
	talrt-max		/* DegreeC */
	valrt-min		/* mV */
	valrt-max		/* mV */
	salrt-min		/* Percent */
	salrt-max		/* Percent */
	ialrt-min		/* mA */
	ialrt-max		/* mA */

Example:

		battery {
			compatible = "maxim,max17332-battery";
		};
```

## MAX17332/driver/mfd/Kconfig
```kconfig
config MFD_MAX17332
	tristate "Maxim Integrated MAX17332 PMIC Support"
	depends on I2C=y
	select MFD_CORE
	select REGMAP_I2C
	select REGMAP_IRQ
	help
	  Say yes here to add support for Maxim Integrated MAX17332. 
```

## MAX17332/driver/power/supply/Kconfig
```kconfig
config POWER_MAX17332
	tristate "Maxim MAX17332 Power Supply driver"
	depends on MFD_MAX17332
	help
	  Say Y to enable support for the Maxim MAX17332 battery charger.
```

## MAX31328/Documentation/devicetree/bindings/rtc-max31328.txt
```
* Maxim MAX31328 Real Time Clock

Required properties:
- compatible: Should contain "maxim,max31328".
- reg: I2C address for chip.

Optional property:
- #clock-cells: Should be 1.

Each clock is assigned an identifier and client nodes can use this identifier
to specify the clock which they consume. Following indices are allowed:
    - 0: square-wave output on the SQW pin
    - 1: square-wave output on the 32kHz pin

- interrupts: rtc alarm/event interrupt. When this property is selected,
  clock on the SQW pin cannot be used.

Example:

max31328: max31328@68 {
	compatible = "maxim,max31328";
	reg = <0x68>;
	#clock-cells = <1>;
};
```

## MAX31341/Documentation/devicetree/bindings/rtc-max31341b.txt
```
Dallas DS1307 and compatible RTC

Required properties:
- compatible: should be one of:
	"maxim,max31341b"
- reg: I2C bus address of the device

Optional properties:
- interrupts: rtc alarm interrupt.
- wakeup-source: Enables wake up of host system on alarm
- trickle-resistor-ohms : Selected resistor for trickle charger
	Possible values are 3000, 6000, 11000
	Should be given if trickle charger should be enabled
- trickle-diode-enable : Enables extra diode for trickle charger
	Should be given if internal trickle charger diode should be enabled
	Should not be given if internal trickle charger diode should be disabled
- backup-threshold : Changes default value of backup threshold voltage
	Possible values are 0 for 1.3V, 1 for 1.7V, 2 for 2.0V, 3 for 2.2V
	Should be given if default value (1.7V) needs to be changed
- power-management: Changes default power management mode (mode 1)
	Possible values are 
	0 for comparator mode,
	1 for power management auto and trickle charger is on,
	2 for power management manual and trickle charger is on, Vcc is active supply
	3 for power management manual and trickle charger is on, AIN is active supply,
	if AIN > Vcc

Example:
	max31341b: max31341b@69 {
		compatible = "maxim,max31341b";
		reg = <0x69>;
		interrupt-parent = <&gpio>;
		interrupts = <16 8>;
		trickle-resistor-ohms=<6000>;
		backup-threshold=<3>;
		power-management=<1>;
		trickle-diode-enable="OK";
	};
```

## MAX31342/Documentation/devicetree/bindings/rtc-max31342.txt
```
Maxim MAX31342 and compatible RTC

Required properties:
- compatible: should be one of:
	"maxim,max31342"
- reg: I2C bus address of the device

Optional properties:
- interrupts: rtc alarm interrupt.
- wakeup-source: Enables wake up of host system on alarm

Example:
	max31342: max31342@69 {
		compatible = "maxim,max31342";
		reg = <0x69>;
		interrupt-parent = <&gpio>;
		interrupts = <16 8>;
	};
```

## MAX31343/Documentation/devicetree/bindings/rtc-max31343.txt
```
Maxim MAX31343 and compatible R

Required properties:
- compatible: should be one of:
	"maxim,max31343"
- reg: I2C bus address of the device

Optional properties:
- interrupts: rtc alarm interrupt.
- wakeup-source: Enables wake up of host system on alarm
- trickle-resistor-ohms : Selected resistor for trickle charger
	Possible values are 3000, 6000, 11000
	Should be given if trickle charger should be enabled
- trickle-diode-enable : Enables extra diode for trickle charger
	Should be given if internal trickle charger diode should be enabled
	Should not be given if internal trickle charger diode should be disabled
- backup-threshold : Changes default value of backup threshold voltage
	Possible values are 0 for 1.8, 1 for 2.0V, 2 for 2.8V
	Should be given if default value (2.8V) needs to be changed
- power-management: Changes default power management mode (mode 1)
	Possible values are 
	0 for power management auto,
	1 for power management manual and Vcc is active supply
	2 for power management manual and Vbat is active supply,
	if AIN > Vcc

Example:
	max31343: max31343@D0 {
		compatible = "maxim,max31343";
		reg = <0xD0>;
		interrupt-parent = <&gpio>;
		interrupts = <16 8>;
		trickle-resistor-ohms=<6000>;
		backup-threshold=<3>;
		power-management=<1>;
		trickle-diode-enable="OK";
	};
```

## MAX31730/Documentation/devicetree/bindings/max31730.txt
```
Maxim MAX31730 3-Channel Remote Temperature Sensor Support

https://datasheets.maximintegrated.com/en/ds/MAX31730.pdf

The node for this driver must be a child node of a I2C controller, hence
all mandatory properties for your controller must be specified. See directory:

        Documentation/devicetree/bindings/i2c

for more details.

Optional property:
	- interrupts: interrupt mapping for GPIO IRQ (level active low). 
	  If not used, the driver will use comparator mode.

Required properties:
	- compatible: must be "maxim,max31730"
	- reg: the I2C address of the sensor (default 0x38 but right shifted 0x1c)
			-----------------------------------
			|RESISTOR BETWEEN | SLAVE ADDRESS |
			|	ADD AND GND	  |		(HEX)	  |
			-----------------------------------
				15kΩ to 39kΩ 		0x9E
					9.31kΩ 			0x9C
					6.81kΩ 			0x9A
					4.75kΩ 			0x98
					3.01kΩ 			0x3E
					1.69kΩ 			0x3C
					750Ω 			0x3A
				  0 (< 250Ω ) 		0x38


 Example:
	max31730@1c {
		compatible = "maxim,max31730";
		reg = <0x1c>;
		interrupt-parent = <&gpio0>;
		interrupts = <16 2>;
	};
```

## MAX34417/Documentation/Kconfig
```kconfig
config SENSORS_MAX34417
	tristate "Maxim MAX34417 sensor chip"
	depends on I2C
	help
	  If you say yes here you get support for MAX34417
      current and voltage monitor.

	  This driver can also be built as a module. If so, the module
	  will be called max34417.
```

## MAX77816/Documentation/devicetree/bindings/regulator/max77816.txt
```
Maxim Integrated MAX77816 High Efficiency Buck-Boost Converter

Required properties:
- compatible: "maxim,max77816"
- reg: I2C slave address

Optional properties:

Example:

	max77816: max77816@18 {
		compatible = "maxim,max77816";
		reg = <0x18>;
	};
```

## MAX77818/Documentation/devicetree/bindings/mfd/max77818.txt
```
Maxim MAX77818 multi-functional device
MAX77818 is a Mulitifunction device with Charger, regulators, and fuelgauge.
* PMIC * Required properties:
 - compatible : Must be "maxim,max77818".
 - interrupt-parent : The parent interrupt controller.
 - interrupts : Interrupt number.
 - interrupt-controller : Mark the device node as an interrupt controller.
 - #interrupt-cells : Should be one. 
 	- The cell is the max77818 local IRQ number

Nodes:
- regulator
- charger
- fulegauge

Example: max77818@66 { 
			compatible = "maxim,max77818";
			#address-cells = <0>;
			max77818,int-gpio = //TBD
			interrupt-parent = //TBD
			interrupts = //TBD
			interrupt-controller;
			#interrupt-cells = <1>;
			reg = <0x66>;
			status = "ok";
			regulator {
				SAFEOUT1 {
					regulator-boot-on;
					regulator-always-on;
				};
				SAFEOUT2 {
					// TBD
				};
			};
			charger {
				compatible = "maxim,max77818-charger";
				status = "disable";
				/* Charger */
				fast_charge_timer = <0>; /* disable(0), hours */
				fast_charge_current = <1500>; /* mA */
				charge_termination_voltage = <4350>; /* mV */
				topoff_timer = <0>; /* min */
				topoff_current = <200> /* mA */
				restart_threshold = <150> /* mV */
				input_current_limit = <500> /* mA */
				// TBD
			};
			fuelgauge {
				compatible = "maxim,max77818-fuelgauge";
				fuelgauge,fuel_alert_soc = <2>;
			};
		};
```

## MAX77818/Documentation/devicetree/bindings/power/max77818-charger.txt
```
Device Tree bindings for max77818 Charger

Required Properties :
 - compatible : Should be "maxim,max77818-charger".

Optional Properties :
 - fast_charge_timer : fast charge timer (hr) 
 - fast_charge_current : fast charge current(mA)
 - charge_termination_voltage : CV voltage(mV)
 - topoff_timer : topoff timer (min)
 - topoff_current : topoff current (mA)
 - restart_threshold : restart threshold (mV)
 - input_current_limit : input current limit (mA)

Example:

		charger {
			compatible = "maxim,max77818-charger";
			fast_charge_current = <450000>;
			fast_charge_timer = <0>;
		};
```

## MAX77818/drivers/power/supply/Kconfig
```kconfig
config POWER_MAX77818
	bool "Maxim Integrated MAX77818 Charger with Fuel Gauge"
	depends on MFD_MAX77818
	help
	  Say yes here to add support for Maxim Integrated MAX77818. 
  	  This is a 3A Switch Mode Charger with Fuel Gauge.
  	  This driver provides common support for accessing the device,
  	  additional drivers must be enabled in order to use the functionality
 	    of the device.
```

## MAX77818/drivers/regulator/Kconfig
```kconfig
#
# Multifunction miscellaneous devices
#

config REGULATOR_MAX77818
	bool "Maxim Integrated MAX77818 Regulator"
	depends on MFD_MAX77818
	help
	  Say yes here to add support for Maxim Integrated MAX77818. 
  	  This is a 3A Switch Mode Charger with Fuel Gauge.
  	  This driver provides common support for accessing the device,
  	  additional drivers must be enabled in order to use the functionality
  	  of the device.
```

## MAX77840/documentation/devicetree/bindings/mfd/max77840.txt
```
Maxim MAX77840 multi-functional device
MAX77840 is a Mulitifunction device with Charger, regulators, and fuelgauge.
* PMIC * Required properties:
 - compatible : Must be "maxim,max77840".
 - interrupt-parent : The parent interrupt controller.
 - interrupts : Interrupt number.
 - interrupt-controller : Mark the device node as an interrupt controller.
 - #interrupt-cells : Should be one. 
 	- The cell is the max77840 local IRQ number

Nodes:
- regulator
- charger
- fulegauge

Example: max77840@66 { 
			compatible = "maxim,max77840";
			interrupt-parent = <&gpio>;
			interrupts = <16 0>;
			interrupt-cells = <1>;
			interrupt-controller;
			reg = <0x66>;
			status = "ok";
			regulator {
				SAFEOUT1 {
					regulator-boot-on;
					regulator-always-on;
				};
			};
			charger {
				compatible = "maxim,max77840-charger";
				status = "disable";
				/* Charger */
				fast_charge_timer = <0>; /* disable */
				fast_charge_current = <1500>; /* mA */
				charge_termination_voltage = <4350>; /* mV */
				topoff_timer = <30>; /* min */
				topoff_current = <150> /* mA */
				restart_threshold = <150> /* mV */
				input_current_limit = <500> /* mA */
				// TBD
			};
			charger-detect{
				compatible = "maxim,max77840-charger-detect";
				status = "disable";
				/* Charger Detect*/
			};
			fuelgauge {
				compatible = "maxim,max77840-fuelgauge";
				fuelgauge,fuel_alert_soc = <2>;
			};
		};
```

## MAX77840/documentation/devicetree/bindings/power/max77840-battery.txt
```
Device Tree bindings for max77840 battery

Required Properties :
 - compatible : Should be "maxim,max77840-fuelgauge".

Optional Properties :
 - fuel_alert_soc : soc min threshold(%)

Example:
		fuelgauge { 
			compatible = "maxim,max77840-fuelgauge";
			fuelgauge,fuel_alert_soc = <2>; 
		}; 
```

## MAX77840/documentation/devicetree/bindings/power/max77840-charger-detect.txt
```
Device Tree bindings for max77840 Charger Detect

Required Properties :
 - compatible : Should be "maxim,max77840-charger=detect".

Optional Properties :
 - 

Example:

		charger {
			compatible = "maxim,max77840-charger-detect";
		};
```
