## MAX77840/documentation/devicetree/bindings/regulator/max77840-regulator.txt
```
Device Tree regulator bindings for max77840 regulator

Required nodes:
- nodes:
  - SAFEOUT1 for safeout1

Optional properties:
- init_data:		regulator constraints

Example:
	regulator {
		SAFEOUT1 {
			regulator-boot-on;
			regulator-always-on;
		};

	};
```

## MAX77840/drivers/mfd/Kconfig
```kconfig
#
# Multifunction miscellaneous devices
#

config MFD_MAX77840
	bool "Maxim Integrated MAX77840 Charger Support"
	depends on I2C=y
	help
	  Say yes here to add support for Maxim Integrated MAX77840. 
	  This is a 3A Switch Mode Charger with Fuel Gauge.
	  This driver provides common support for accessing the device,
	  additional drivers must be enabled in order to use the functionality
	  of the device.
```

## MAX77840/drivers/power/supply/Kconfig
```kconfig
config POWER_MAX77840
	bool "Maxim Integrated MAX77840 Charger with Fuel Gauge"
	depends on MFD_MAX77840
	help
	  Say Y to enable support for Maxim Integrated MAX77840. 
  	  This is a 3A Switch Mode Charger with Fuel Gauge.
  	  This driver provides common support for accessing the device,
  	  additional drivers must be enabled in order to use the functionality
 	  of the device.
```

## MAX77860/Documentation/devicetree/bindings/iio/adc/max77860-adc.txt
```
Device Tree bindings for max77860 adc

Required Properties :
 - compatible : Should be "maxim,max77860-adc".

Optional Properties :
 - vbus_hv_range = <0>; /* 2.7V-6.3V LSB = 14mV */
 - filter_averaging = <0>; /* 2-points avg */
 - channel_enable = <0xFF>; /* all */
 - filter_enable = <0>; /* none */

Example:
		adc {
			compatible = "maxim,max77860-adc";
			status = "ok";
			vbus_hv_range = <0>; /* 2.7V-6.3V LSB = 14mV */
			filter_averaging = <0>; /* 2-points avg */
			channel_enable = <0xFF>; /* all */
			filter_enable = <0>; /* none */
		};
```

## MAX77860/Documentation/devicetree/bindings/mfd/max77860.txt
```
Maxim MAX77860 multi-functional device
MAX77860 is a Mulitifunction device with USB Type-C, charger, regulators, and ADC.
* PMIC * Required properties:
 - compatible : Must be "maxim,max77860".
 - interrupt-parent : The parent interrupt controller.
 - interrupts : Interrupt number.
 - interrupt-controller : Mark the device node as an interrupt controller.
 - #interrupt-cells : Should be one. 
 	- The cell is the max77860 local IRQ number

Nodes:
- regulator
- charger
- usbc
- adc

Example: max77860@66 {
			compatible = "maxim,max77860";
			interrupt-parent = <&gpio>;
			interrupts = <16 0>;
			interrupt-cells = <1>;
			interrupt-controller;
			reg = <0x66>;
			status = "ok";
	
			regulator {
				SAFEOUT1 {
					regulator-boot-on;
					regulator-always-on;
				};
			};
			charger {
				compatible = "maxim,max77860-charger";
				status = "ok";
				/* Charger */
				fast_charge_timer = <0>; /* disable */
				fast_charge_current = <1500>; /* mA */
				charge_termination_voltage = <4350>; /* mV */
				topoff_timer = <30>; /* min */
				topoff_current = <150>; /* mA */
				restart_threshold = <150>; /* mV */
				input_current_limit = <500>; /* mA */
			};
			usbc {
				compatible = "maxim,max77860-usbc";
				status = "ok";
			};
			adc {
				compatible = "maxim,max77860-adc";
				status = "ok";
				vbus_hv_range = <0>; /* 2.7V-6.3V LSB = 14mV */
				filter_averaging = <0>; /* 2-points avg */
				channel_enable = <0xFF>; /* all */
				filter_enable = <0>; /* none */
			};
```
